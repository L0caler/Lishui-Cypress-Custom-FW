;  Generated by PSoC Designer 5.4.3191
;
;
;  PSoCGPIOINT.inc
;
;  Data: 29 October, 2001
;  Copyright (c) Cypress Semiconductor 2015. All Rights Reserved.
;
;  This file is generated by the Device Editor on Application Generation.
;  It contains equates that are useful in writing code relating to GPIO
;  related interrupts.
;  
;  DO NOT EDIT THIS FILE MANUALLY, AS IT IS OVERWRITTEN!!!
;  Edits to this file will not be preserved.
;
; HALL2 address and mask equates
HALL2_Data_ADDR:	equ	8h
HALL2_DriveMode_0_ADDR:	equ	108h
HALL2_DriveMode_1_ADDR:	equ	109h
HALL2_DriveMode_2_ADDR:	equ	bh
HALL2_GlobalSelect_ADDR:	equ	ah
HALL2_IntCtrl_0_ADDR:	equ	10ah
HALL2_IntCtrl_1_ADDR:	equ	10bh
HALL2_IntEn_ADDR:	equ	9h
HALL2_MASK:	equ	2h
; HALL1 address and mask equates
HALL1_Data_ADDR:	equ	8h
HALL1_DriveMode_0_ADDR:	equ	108h
HALL1_DriveMode_1_ADDR:	equ	109h
HALL1_DriveMode_2_ADDR:	equ	bh
HALL1_GlobalSelect_ADDR:	equ	ah
HALL1_IntCtrl_0_ADDR:	equ	10ah
HALL1_IntCtrl_1_ADDR:	equ	10bh
HALL1_IntEn_ADDR:	equ	9h
HALL1_MASK:	equ	1h
; HALL3 address and mask equates
HALL3_Data_ADDR:	equ	8h
HALL3_DriveMode_0_ADDR:	equ	108h
HALL3_DriveMode_1_ADDR:	equ	109h
HALL3_DriveMode_2_ADDR:	equ	bh
HALL3_GlobalSelect_ADDR:	equ	ah
HALL3_IntCtrl_0_ADDR:	equ	10ah
HALL3_IntCtrl_1_ADDR:	equ	10bh
HALL3_IntEn_ADDR:	equ	9h
HALL3_MASK:	equ	4h
; Current_sense address and mask equates
Current_sense_Data_ADDR:	equ	0h
Current_sense_DriveMode_0_ADDR:	equ	100h
Current_sense_DriveMode_1_ADDR:	equ	101h
Current_sense_DriveMode_2_ADDR:	equ	3h
Current_sense_GlobalSelect_ADDR:	equ	2h
Current_sense_IntCtrl_0_ADDR:	equ	102h
Current_sense_IntCtrl_1_ADDR:	equ	103h
Current_sense_IntEn_ADDR:	equ	1h
Current_sense_MASK:	equ	2h
; POR_THROTTLE_CONNECTOR address and mask equates
POR_THROTTLE_CONNECTOR_Data_ADDR:	equ	0h
POR_THROTTLE_CONNECTOR_DriveMode_0_ADDR:	equ	100h
POR_THROTTLE_CONNECTOR_DriveMode_1_ADDR:	equ	101h
POR_THROTTLE_CONNECTOR_DriveMode_2_ADDR:	equ	3h
POR_THROTTLE_CONNECTOR_GlobalSelect_ADDR:	equ	2h
POR_THROTTLE_CONNECTOR_IntCtrl_0_ADDR:	equ	102h
POR_THROTTLE_CONNECTOR_IntCtrl_1_ADDR:	equ	103h
POR_THROTTLE_CONNECTOR_IntEn_ADDR:	equ	1h
POR_THROTTLE_CONNECTOR_MASK:	equ	4h
; VBAT_SENSE address and mask equates
VBAT_SENSE_Data_ADDR:	equ	0h
VBAT_SENSE_DriveMode_0_ADDR:	equ	100h
VBAT_SENSE_DriveMode_1_ADDR:	equ	101h
VBAT_SENSE_DriveMode_2_ADDR:	equ	3h
VBAT_SENSE_GlobalSelect_ADDR:	equ	2h
VBAT_SENSE_IntCtrl_0_ADDR:	equ	102h
VBAT_SENSE_IntCtrl_1_ADDR:	equ	103h
VBAT_SENSE_IntEn_ADDR:	equ	1h
VBAT_SENSE_MASK:	equ	40h
; PAS_VP_CONNECTOR address and mask equates
PAS_VP_CONNECTOR_Data_ADDR:	equ	0h
PAS_VP_CONNECTOR_DriveMode_0_ADDR:	equ	100h
PAS_VP_CONNECTOR_DriveMode_1_ADDR:	equ	101h
PAS_VP_CONNECTOR_DriveMode_2_ADDR:	equ	3h
PAS_VP_CONNECTOR_GlobalSelect_ADDR:	equ	2h
PAS_VP_CONNECTOR_IntCtrl_0_ADDR:	equ	102h
PAS_VP_CONNECTOR_IntCtrl_1_ADDR:	equ	103h
PAS_VP_CONNECTOR_IntEn_ADDR:	equ	1h
PAS_VP_CONNECTOR_MASK:	equ	80h
; UART_TX address and mask equates
UART_TX_Data_ADDR:	equ	4h
UART_TX_DriveMode_0_ADDR:	equ	104h
UART_TX_DriveMode_1_ADDR:	equ	105h
UART_TX_DriveMode_2_ADDR:	equ	7h
UART_TX_GlobalSelect_ADDR:	equ	6h
UART_TX_IntCtrl_0_ADDR:	equ	106h
UART_TX_IntCtrl_1_ADDR:	equ	107h
UART_TX_IntEn_ADDR:	equ	5h
UART_TX_MASK:	equ	1h
; UART_RX address and mask equates
UART_RX_Data_ADDR:	equ	4h
UART_RX_DriveMode_0_ADDR:	equ	104h
UART_RX_DriveMode_1_ADDR:	equ	105h
UART_RX_DriveMode_2_ADDR:	equ	7h
UART_RX_GlobalSelect_ADDR:	equ	6h
UART_RX_IntCtrl_0_ADDR:	equ	106h
UART_RX_IntCtrl_1_ADDR:	equ	107h
UART_RX_IntEn_ADDR:	equ	5h
UART_RX_MASK:	equ	2h
; Gate_B_NLIN address and mask equates
Gate_B_NLIN_Data_ADDR:	equ	4h
Gate_B_NLIN_DriveMode_0_ADDR:	equ	104h
Gate_B_NLIN_DriveMode_1_ADDR:	equ	105h
Gate_B_NLIN_DriveMode_2_ADDR:	equ	7h
Gate_B_NLIN_GlobalSelect_ADDR:	equ	6h
Gate_B_NLIN_IntCtrl_0_ADDR:	equ	106h
Gate_B_NLIN_IntCtrl_1_ADDR:	equ	107h
Gate_B_NLIN_IntEn_ADDR:	equ	5h
Gate_B_NLIN_MASK:	equ	4h
; Gate_B_HIN address and mask equates
Gate_B_HIN_Data_ADDR:	equ	4h
Gate_B_HIN_DriveMode_0_ADDR:	equ	104h
Gate_B_HIN_DriveMode_1_ADDR:	equ	105h
Gate_B_HIN_DriveMode_2_ADDR:	equ	7h
Gate_B_HIN_GlobalSelect_ADDR:	equ	6h
Gate_B_HIN_IntCtrl_0_ADDR:	equ	106h
Gate_B_HIN_IntCtrl_1_ADDR:	equ	107h
Gate_B_HIN_IntEn_ADDR:	equ	5h
Gate_B_HIN_MASK:	equ	8h
; BRAKE_CONNECTOR address and mask equates
BRAKE_CONNECTOR_Data_ADDR:	equ	4h
BRAKE_CONNECTOR_DriveMode_0_ADDR:	equ	104h
BRAKE_CONNECTOR_DriveMode_1_ADDR:	equ	105h
BRAKE_CONNECTOR_DriveMode_2_ADDR:	equ	7h
BRAKE_CONNECTOR_GlobalSelect_ADDR:	equ	6h
BRAKE_CONNECTOR_IntCtrl_0_ADDR:	equ	106h
BRAKE_CONNECTOR_IntCtrl_1_ADDR:	equ	107h
BRAKE_CONNECTOR_IntEn_ADDR:	equ	5h
BRAKE_CONNECTOR_MASK:	equ	20h
; Gate_A_NLIN address and mask equates
Gate_A_NLIN_Data_ADDR:	equ	4h
Gate_A_NLIN_DriveMode_0_ADDR:	equ	104h
Gate_A_NLIN_DriveMode_1_ADDR:	equ	105h
Gate_A_NLIN_DriveMode_2_ADDR:	equ	7h
Gate_A_NLIN_GlobalSelect_ADDR:	equ	6h
Gate_A_NLIN_IntCtrl_0_ADDR:	equ	106h
Gate_A_NLIN_IntCtrl_1_ADDR:	equ	107h
Gate_A_NLIN_IntEn_ADDR:	equ	5h
Gate_A_NLIN_MASK:	equ	40h
; Gate_A_HIN address and mask equates
Gate_A_HIN_Data_ADDR:	equ	4h
Gate_A_HIN_DriveMode_0_ADDR:	equ	104h
Gate_A_HIN_DriveMode_1_ADDR:	equ	105h
Gate_A_HIN_DriveMode_2_ADDR:	equ	7h
Gate_A_HIN_GlobalSelect_ADDR:	equ	6h
Gate_A_HIN_IntCtrl_0_ADDR:	equ	106h
Gate_A_HIN_IntCtrl_1_ADDR:	equ	107h
Gate_A_HIN_IntEn_ADDR:	equ	5h
Gate_A_HIN_MASK:	equ	80h
; LED_EN address and mask equates
LED_EN_Data_ADDR:	equ	8h
LED_EN_DriveMode_0_ADDR:	equ	108h
LED_EN_DriveMode_1_ADDR:	equ	109h
LED_EN_DriveMode_2_ADDR:	equ	bh
LED_EN_GlobalSelect_ADDR:	equ	ah
LED_EN_IntCtrl_0_ADDR:	equ	10ah
LED_EN_IntCtrl_1_ADDR:	equ	10bh
LED_EN_IntEn_ADDR:	equ	9h
LED_EN_MASK:	equ	20h
; Gate_C_NLIN address and mask equates
Gate_C_NLIN_Data_ADDR:	equ	8h
Gate_C_NLIN_DriveMode_0_ADDR:	equ	108h
Gate_C_NLIN_DriveMode_1_ADDR:	equ	109h
Gate_C_NLIN_DriveMode_2_ADDR:	equ	bh
Gate_C_NLIN_GlobalSelect_ADDR:	equ	ah
Gate_C_NLIN_IntCtrl_0_ADDR:	equ	10ah
Gate_C_NLIN_IntCtrl_1_ADDR:	equ	10bh
Gate_C_NLIN_IntEn_ADDR:	equ	9h
Gate_C_NLIN_MASK:	equ	40h
; Gate_C_HIN address and mask equates
Gate_C_HIN_Data_ADDR:	equ	8h
Gate_C_HIN_DriveMode_0_ADDR:	equ	108h
Gate_C_HIN_DriveMode_1_ADDR:	equ	109h
Gate_C_HIN_DriveMode_2_ADDR:	equ	bh
Gate_C_HIN_GlobalSelect_ADDR:	equ	ah
Gate_C_HIN_IntCtrl_0_ADDR:	equ	10ah
Gate_C_HIN_IntCtrl_1_ADDR:	equ	10bh
Gate_C_HIN_IntEn_ADDR:	equ	9h
Gate_C_HIN_MASK:	equ	80h
